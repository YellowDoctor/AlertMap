#pragma once

#include <Arduino.h>
#include <string.h>

struct LedDistrictMapping {
    uint8_t led_index;       // 0..127 (відповідає світлодіодам 1..128)
    const char* name;        // Назва міста/центру
    const char* district;    // Офіційна назва району
    const char* oblast;      // Область
    const char* alt_names;   // Синоніми / старі назви / ключові слова через кому
};

static const LedDistrictMapping LED_DISTRICT_MAP[128] = {
    {0, "Ізмаїл", "Ізмаїльський район", "Одеська область", "Ізмаїл,Ізмаїльськ"},
    {1, "Болград", "Болградський район", "Одеська область", "Болград,Болградськ"},
    {2, "Білгород-Дністровський", "Білгород-Дністровський район", "Одеська область", "Білгород-Дністровський,Білгород-Дністровськ"},
    {3, "Одеса", "Одеський район", "Одеська область", "Одеса,м. Одеса,Одеськ"},
    {4, "Березівка", "Березівський район", "Одеська область", "Березівка,Березівськ"},
    {5, "Роздільна", "Роздільнянський район", "Одеська область", "Роздільна,Роздільнянськ"},
    {6, "Подільськ", "Подільський район", "Одеська область", "Подільськ,Подільський"},

    {7, "Гайсин", "Гайсинський район", "Вінницька область", "Гайсин,Гайсинськ"},
    {8, "Тульчин", "Тульчинський район", "Вінницька область", "Тульчин,Тульчинськ"},
    {9, "Вінниця", "Вінницький район", "Вінницька область", "Вінниця,м. Вінниця,Вінницьк"},
    {10, "Хмільник", "Хмільницький район", "Вінницька область", "Хмільник,Хмільницьк"},
    {11, "Жмеринка", "Жмеринський район", "Вінницька область", "Жмеринка,Жмеринськ"},
    {12, "Могилів-Подільський", "Могилів-Подільський район", "Вінницька область", "Могилів-Подільський,Могилів-Подільськ"},

    {13, "Кельменці", "Дністровський район", "Чернівецька область", "Кельменці,Кельменецький,Дністровський"},
    {14, "Чернівці", "Чернівецький район", "Чернівецька область", "Чернівці,м. Чернівці,Чернівецьк"},
    {15, "Вижниця", "Вижницький район", "Чернівецька область", "Вижниця,Вижницьк"},

    {16, "Верховина", "Верховинський район", "Івано-Франківська область", "Верховина,Верховинськ"},
    {17, "Косів", "Косівський район", "Івано-Франківська область", "Косів,Косівськ"},
    {18, "Коломия", "Коломийський район", "Івано-Франківська область", "Коломия,Коломийськ"},
    {19, "Надвірна", "Надвірнянський район", "Івано-Франківська область", "Надвірна,Надвірнянськ"},
    {20, "Івано-Франківськ", "Івано-Франківський район", "Івано-Франківська область", "Івано-Франківськ,м. Івано-Франківськ,Івано-Франківськ"},
    {21, "Калуш", "Калуський район", "Івано-Франківська область", "Калуш,Калуськ"},

    {22, "Рахів", "Рахівський район", "Закарпатська область", "Рахів,Рахівськ"},
    {23, "Тячів", "Тячівський район", "Закарпатська область", "Тячів,Тячівськ"},
    {24, "Хуст", "Хустський район", "Закарпатська область", "Хуст,Хустськ"},
    {25, "Берегове", "Берегівський район", "Закарпатська область", "Берегове,Берегово,Берегівськ"},
    {26, "Мукачево", "Мукачівський район", "Закарпатська область", "Мукачево,Мукачеве,Мукачівськ"},
    {27, "Ужгород", "Ужгородський район", "Закарпатська область", "Ужгород,м. Ужгород,Ужгородськ"},

    {28, "Стрий", "Стрийський район", "Львівська область", "Стрий,Стрийськ"},
    {29, "Дрогобич", "Дрогобицький район", "Львівська область", "Дрогобич,Дрогобицьк"},
    {30, "Самбір", "Самбірський район", "Львівська область", "Самбір,Самбірськ"},
    {31, "Яворів", "Яворівський район", "Львівська область", "Яворів,Яворівськ"},
    {32, "Львів", "Львівський район", "Львівська область", "Львів,м. Львів,Львівськ"},
    {33, "Золочів", "Золочівський район", "Львівська область", "Золочів,Золочівськ"},
    {34, "Шептицький", "Шептицький район", "Львівська область", "Шептицький,Червоноград,Червоноградський,Шептицьк"},

    {35, "Володимир", "Володимирський район", "Волинська область", "Володимир,Володимир-Волинський,Володимирськ"},
    {36, "Луцьк", "Луцький район", "Волинська область", "Луцьк,м. Луцьк,Луцьк"},
    {37, "Ковель", "Ковельський район", "Волинська область", "Ковель,Ковельськ"},
    {38, "Камінь-Каширський", "Камінь-Каширський район", "Волинська область", "Камінь-Каширський,Камінь-Каширськ"},

    {39, "Вараш", "Вараський район", "Рівненська область", "Вараш,Вараськ"},
    {40, "Сарни", "Сарненський район", "Рівненська область", "Сарни,Сарненськ"},
    {41, "Рівне", "Рівненський район", "Рівненська область", "Рівне,м. Рівне,Рівненськ"},
    {42, "Дубно", "Дубенський район", "Рівненська область", "Дубно,Дубенськ"},

    {43, "Кременець", "Кременецький район", "Тернопільська область", "Кременець,Кременецьк"},
    {44, "Тернопіль", "Тернопільський район", "Тернопільська область", "Тернопіль,м. Тернопіль,Тернопільськ"},
    {45, "Чортків", "Чортківський район", "Тернопільська область", "Чортків,Чортківськ"},

    {46, "Кам'янець-Подільський", "Кам'янець-Подільський район", "Хмельницька область", "Кам'янець-Подільський,Кам'янець-Подільськ"},
    {47, "Хмельницький", "Хмельницький район", "Хмельницька область", "Хмельницький,м. Хмельницький,Хмельницьк"},
    {48, "Шепетівка", "Шепетівський район", "Хмельницька область", "Шепетівка,Шепетівськ"},

    {49, "Бердичів", "Бердичівський район", "Житомирська область", "Бердичів,Бердичівськ"},
    {50, "Житомир", "Житомирський район", "Житомирська область", "Житомир,м. Житомир,Житомирськ"},
    {51, "Звягель", "Звягельський район", "Житомирська область", "Звягель,Новоград-Волинський,Звягельськ"},
    {52, "Коростень", "Коростенський район", "Житомирська область", "Коростень,Коростенськ"},

    {53, "Вишгород", "Вишгородський район", "Київська область", "Вишгород,Вишгородськ"},
    {54, "Буча", "Бучанський район", "Київська область", "Буча,Бучанськ"},
    {55, "Київ", "м. Київ", "м. Київ", "Київ,м. Київ,місто Київ"},
    {56, "Бровари", "Броварський район", "Київська область", "Бровари,Броварськ"},
    {57, "Бориспіль", "Бориспільський район", "Київська область", "Бориспіль,Бориспільськ"},
    {58, "Фастів", "Фастівський район", "Київська область", "Фастів,Фастівськ"},
    {59, "Біла Церква", "Білоцерківський район", "Київська область", "Біла Церква,Білоцерківськ"},
    {60, "Обухів", "Обухівський район", "Київська область", "Обухів,Обухівськ"},

    {61, "Голованівськ", "Голованівський район", "Кіровоградська область", "Голованівськ,Голованівськ"},
    {62, "Звенигородка", "Звенигородський район", "Черкаська область", "Звенигородка,Звенигородськ"},
    {63, "Золотоноша", "Золотоніський район", "Черкаська область", "Золотоноша,Золотоніськ"},
    {64, "Черкаси", "Черкаський район", "Черкаська область", "Черкаси,м. Черкаси,Черкаськ"},

    {65, "Олександрія", "Олександрійський район", "Кіровоградська область", "Олександрія,Олександрійськ"},
    {66, "Кропивницький", "Кропивницький район", "Кіровоградська область", "Кропивницький,м. Кропивницький,Кропивницьк"},
    {67, "Новоукраїнка", "Новоукраїнський район", "Кіровоградська область", "Новоукраїнка,Новоукраїнськ"},

    {68, "Умань", "Уманський район", "Черкаська область", "Умань,Уманськ"},

    {69, "Первомайськ", "Первомайський район", "Миколаївська область", "Первомайськ,Первомайськ"},
    {70, "Баштанка", "Баштанський район", "Миколаївська область", "Баштанка,Баштанськ"},
    {71, "Миколаїв", "Миколаївський район", "Миколаївська область", "Миколаїв,м. Миколаїв,Миколаївськ"},
    {72, "Вознесенськ", "Вознесенський район", "Миколаївська область", "Вознесенськ,Вознесенськ"},

    {73, "Кривий Ріг", "Криворізький район", "Дніпропетровська область", "Кривий Ріг,м. Кривий Ріг,Криворізьк"},
    {74, "Запоріжжя", "Запорізький район", "Запорізька область", "Запоріжжя,м. Запоріжжя,Запорізьк"},
    {75, "Кам'янське", "Кам'янський район", "Дніпропетровська область", "Кам'янське,Кам'янськ"},
    {76, "Синельникове", "Синельниківський район", "Дніпропетровська область", "Синельникове,Синельниківськ"},
    {77, "Павлоград", "Павлоградський район", "Дніпропетровська область", "Павлоград,Павлоградськ"},
    {78, "Дніпро", "Дніпровський район", "Дніпропетровська область", "Дніпро,м. Дніпро,Дніпровськ"},
    {79, "Самар", "Самарівський район", "Дніпропетровська область", "Самар,Самарівський,Новомосковськ,Новомосковський"},

    {80, "Кременчук", "Кременчуцький район", "Полтавська область", "Кременчук,Кременчуцьк"},
    {81, "Полтава", "Полтавський район", "Полтавська область", "Полтава,м. Полтава,Полтавськ"},
    {82, "Миргород", "Миргородський район", "Полтавська область", "Миргород,Миргородськ"},
    {83, "Лубни", "Лубенський район", "Полтавська область", "Лубни,Лубенськ"},

    {84, "Прилуки", "Прилуцький район", "Чернігівська область", "Прилуки,Прилуцьк"},
    {85, "Ніжин", "Ніжинський район", "Чернігівська область", "Ніжин,Ніжинськ"},
    {86, "Чернігів", "Чернігівський район", "Чернігівська область", "Чернігів,м. Чернігів,Чернігівськ"},
    {87, "Корюківка", "Корюківський район", "Чернігівська область", "Корюківка,Корюківськ"},
    {88, "Новгород-Сіверський", "Новгород-Сіверський район", "Чернігівська область", "Новгород-Сіверський,Новгород-Сіверськ"},

    {89, "Шостка", "Шосткинський район", "Сумська область", "Шостка,Шосткинськ"},
    {90, "Конотоп", "Конотопський район", "Сумська область", "Конотоп,Конотопськ"},
    {91, "Ромни", "Роменський район", "Сумська область", "Ромни,Роменськ"},
    {92, "Суми", "Сумський район", "Сумська область", "Суми,м. Суми,Сумськ"},
    {93, "Охтирка", "Охтирський район", "Сумська область", "Охтирка,Охтирськ"},

    {94, "Богодухів", "Богодухівський район", "Харківська область", "Богодухів,Богодухівськ"},
    {95, "Харків", "Харківський район", "Харківська область", "Харків,м. Харків,Харківськ"},
    {96, "Берестин", "Берестинський район", "Харківська область", "Берестин,Берестинський,Красноград,Красноградський"},
    {97, "Лозова", "Лозівський район", "Харківська область", "Лозова,Лозівськ"},
    {98, "Чугуїв", "Чугуївський район", "Харківська область", "Чугуїв,Чугуївськ"},
    {99, "Куп'янськ", "Куп'янський район", "Харківська область", "Куп'янськ,Куп'янськ"},
    {100, "Ізюм", "Ізюмський район", "Харківська область", "Ізюм,Ізюмськ"},

    {101, "Сватове", "Сватівський район", "Луганська область", "Сватове,Сватівськ"},
    {102, "Старобільськ", "Старобільський район", "Луганська область", "Старобільськ,Старобільськ"},
    {103, "Сіверськодонецьк", "Сєвєродонецький район", "Луганська область", "Сіверськодонецьк,Сєвєродонецьк,Сєвєродонецький"},
    {104, "Новоайдар", "Щастинський район", "Луганська область", "Новоайдар,Щастя,Щастинський"},
    {105, "Луганськ", "Луганський район", "Луганська область", "Луганськ,м. Луганськ,Луганськ"},
    {106, "Алчевськ", "Алчевський район", "Луганська область", "Алчевськ,Алчевськ"},
    {107, "Довжанськ", "Довжанський район", "Луганська область", "Довжанськ,Свердловськ,Довжанськ"},
    {108, "Ровеньки", "Ровеньківський район", "Луганська область", "Ровеньки,Ровеньківськ"},

    {109, "Донецьк", "Донецький район", "Донецька область", "Донецьк,м. Донецьк,Донецьк"},
    {110, "Горлівка", "Горлівський район", "Донецька область", "Горлівка,Горлівськ"},
    {111, "Бахмут", "Бахмутський район", "Донецька область", "Бахмут,Бахмутськ"},
    {112, "Краматорськ", "Краматорський район", "Донецька область", "Краматорськ,Краматорськ"},
    {113, "Покровськ", "Покровський район", "Донецька область", "Покровськ,Покровськ"},
    {114, "Волноваха", "Волноваський район", "Донецька область", "Волноваха,Волноваськ"},
    {115, "Кальміуське", "Кальміуський район", "Донецька область", "Кальміуське,Кальміуськ"},
    {116, "Маріуполь", "Маріупольський район", "Донецька область", "Маріуполь,Маріупольськ"},

    {117, "Бердянськ", "Бердянський район", "Запорізька область", "Бердянськ,Бердянськ"},
    {118, "Пологи", "Пологівський район", "Запорізька область", "Пологи,Пологівськ"},

    {119, "Нікополь", "Нікопольський район", "Дніпропетровська область", "Нікополь,Нікопольськ"},

    {120, "Василівка", "Василівський район", "Запорізька область", "Василівка,Василівськ"},
    {121, "Мелітополь", "Мелітопольський район", "Запорізька область", "Мелітополь,Мелітопольськ"},

    {122, "Генічеськ", "Генічеський район", "Херсонська область", "Генічеськ,Генічеськ"},
    {123, "Нова Каховка", "Каховський район", "Херсонська область", "Нова Каховка,Каховка,Каховський"},
    {124, "Берислав", "Бериславський район", "Херсонська область", "Берислав,Бериславськ"},
    {125, "Херсон", "Херсонський район", "Херсонська область", "Херсон,м. Херсон,Херсонськ"},
    {126, "Скадовськ", "Скадовський район", "Херсонська область", "Скадовськ,Скадовськ"},

    {127, "Сімферополь", "Сімферопольський район", "Автономна Республіка Крим", "Сімферополь,Крим,АР Крим,м. Севастополь,Севастополь"}
};

// Розумний пошук світлодіодів для області (повертає кількість знайдених)
inline uint8_t getLedsForOblast(const char* oblast_name, uint8_t* result, uint8_t maxResults) {
    if (!oblast_name) return 0;
    uint8_t count = 0;
    for (uint8_t i = 0; i < 128; i++) {
        if (strstr(oblast_name, LED_DISTRICT_MAP[i].oblast) != nullptr || 
            strstr(LED_DISTRICT_MAP[i].oblast, oblast_name) != nullptr) {
            if (count < maxResults) {
                result[count++] = LED_DISTRICT_MAP[i].led_index;
            }
        }
    }
    return count;
}

// Розумний пошук світлодіода за назвою району, міста або синонімами
inline int16_t findLedByLocationName(const char* title, const char* raion, const char* oblast) {
    if (!title && !raion) return -1;

    // 1. Прямий або частковий збіг по району/назві
    for (uint8_t i = 0; i < 128; i++) {
        // Якщо передано назву району (location_raion)
        if (raion && strlen(raion) > 0) {
            if (strstr(raion, LED_DISTRICT_MAP[i].name) != nullptr ||
                strstr(raion, LED_DISTRICT_MAP[i].district) != nullptr) {
                // Додаткова перевірка області, якщо вказана
                if (!oblast || strlen(oblast) == 0 || strstr(oblast, LED_DISTRICT_MAP[i].oblast) != nullptr || strstr(LED_DISTRICT_MAP[i].oblast, oblast) != nullptr) {
                    return LED_DISTRICT_MAP[i].led_index;
                }
            }
        }

        // Пошук по основному заголовку (location_title)
        if (title && strlen(title) > 0) {
            if (strstr(title, LED_DISTRICT_MAP[i].name) != nullptr ||
                strstr(title, LED_DISTRICT_MAP[i].district) != nullptr) {
                if (!oblast || strlen(oblast) == 0 || strstr(oblast, LED_DISTRICT_MAP[i].oblast) != nullptr || strstr(LED_DISTRICT_MAP[i].oblast, oblast) != nullptr) {
                    return LED_DISTRICT_MAP[i].led_index;
                }
            }

            // Пошук по альтернативних назвах / синонімах (через кому)
            if (LED_DISTRICT_MAP[i].alt_names) {
                char altBuf[128];
                strncpy(altBuf, LED_DISTRICT_MAP[i].alt_names, sizeof(altBuf) - 1);
                altBuf[sizeof(altBuf) - 1] = '\0';
                char* token = strtok(altBuf, ",");
                while (token != nullptr) {
                    if (strstr(title, token) != nullptr || (raion && strstr(raion, token) != nullptr)) {
                        return LED_DISTRICT_MAP[i].led_index;
                    }
                    token = strtok(nullptr, ",");
                }
            }
        }
    }
    return -1;
}